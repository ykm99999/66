## 888/mt7981_sl3000_defconfig
```kconfig
CONFIG_ARM=y
CONFIG_SYS_ARCH_TIMER=y
CONFIG_ARCH_MEDIATEK=y
CONFIG_SYS_TEXT_BASE=0x41e00000
CONFIG_TARGET_MT7981=y
CONFIG_DEFAULT_DEVICE_TREE="mt7981-spim-nor"
CONFIG_IDENT_STRING=" SL-3000-RECOVERY"
CONFIG_SYS_LOAD_ADDR=0x46000000
CONFIG_DEBUG_UART=y
CONFIG_DEBUG_UART_BASE=0x11002000
CONFIG_DEBUG_UART_CLOCK=40000000
CONFIG_AHCI=y
CONFIG_DISTRO_DEFAULTS=y
CONFIG_BOOTDELAY=3
CONFIG_DEFAULT_FDT_FILE="mt7981-spim-nor"
CONFIG_SYS_PROMPT="MT7981> "
CONFIG_CMD_BOOTMENU=y
CONFIG_CMD_MTD=y
CONFIG_CMD_SPI=y
CONFIG_CMD_FS_GENERIC=y
# 物理硬化分区表：将 bl2 锁定为 1M 偏移，确保救砖成功
CONFIG_MTDPARTS_DEFAULT="mtdparts=spi0.0:1M(bl2),512k(u-boot-env),2M(factory),2M(fip),-(uboot)"
CONFIG_OF_CONTROL=y
CONFIG_ENV_IS_IN_SPI_FLASH=y
CONFIG_DM_SPI_FLASH=y
CONFIG_SPI_FLASH_MTD=y
CONFIG_MEDIATEK_ETH=y
CONFIG_MTK_SPIM=y
CONFIG_LZO=y
```
